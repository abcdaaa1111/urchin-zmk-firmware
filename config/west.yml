## config/west.yml
```yaml
manifest:
  remotes:
    # zmk official
    - name: zmkfirmware
      url-base: https://github.com/zmkfirmware
      # bravekarma
    - name: caksoylar
      url-base: https://github.com/caksoylar
      # 
    - name: abcdaaa1111
      url-base: https://github.com/abcdaaa1111
      # nice-view-gem
    - name: m165437
      url-base: https://github.com/M165437
  projects:
    - name: zmk
      remote: zmkfirmware
      revision: v0.3.0
      import: app/west.yml
    - name: urchin-zmk-module
      remote: abcdaaa1111
      revision: main
    - name: nice-view-gem
      remote: m165437
      revision: main
  self:
    path: config
```
